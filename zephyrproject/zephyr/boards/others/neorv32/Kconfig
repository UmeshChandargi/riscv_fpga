## zephyrproject/zephyr/boards/others/neorv32/Kconfig
```kconfig
# Copyright (c) 2021 Henrik Brix Andersen <henrik@brixandersen.dk>
# SPDX-License-Identifier: Apache-2.0

config BOARD_NEORV32
	select SOC_NEORV32_V1_9_8 if "$(BOARD_REVISION)" = "1.9.8"

config NEORV_ZEDBOARD_GEM_OCM_CFG
    bool "Enable NEORV ZedBoard OCM Configuration"
    default n
    help
      This option enables the NEORV ZedBoard On-Chip Memory (OCM) configuration.
```
